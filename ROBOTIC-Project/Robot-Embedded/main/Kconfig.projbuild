## ROBOTIC-Project/Robot-Embedded/main/Kconfig.projbuild
```kconfig
menu "Robot ESP IDF Configuration"

  config ESP_WIFI_SSID
    string "iPhone de Antoine"
    default "myssid"
    help
      SSID (network name) for the example to connect to.

  config ESP_WIFI_PASSWORD
    string "00000000"
    default "mypassword"
    help
      WiFi password (WPA or WPA2) for the example to use.

endmenu
```
